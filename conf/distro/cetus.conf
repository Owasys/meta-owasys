## conf/distro/cetus.conf
```bitbake
# Distro for owa5x ( Cetus ).

require conf/distro/include/fslc-base.inc

DISTRO = "cetus"
DISTRO_NAME = "Cetus"

# Remove conflicting backends
DISTRO_FEATURES:remove = " wayland directfb x11"
DISTRO_FEATURES:append = " pam systemd "
VIRTUAL-RUNTIME_init_manager = "systemd"
MACHINEOVERRIDES =. "imx-generic-bsp"
```

## conf/layer.conf
```bitbake
# We have a conf and classes directory, add to BBPATH
BBPATH .= ":${LAYERDIR}"

# We have a packages directory, add to BBFILES
BBFILES += "${LAYERDIR}/recipes-*/*/*.bb \
            ${LAYERDIR}/recipes-*/*/*.bbappend"

# Add the Owasys licenses into the metadata
LICENSE_PATH += "${LAYERDIR}/custom-licenses"
COMPANY_CUSTOM_LICENSES := '${@os.path.normpath("${LAYERDIR}/custom-licenses")}'
#BB_HASHBASE_WHITELIST:append = " COMPANY_COMMON_LICENSES"
FSL_EULA_FILE = "${LAYERDIR}/LICENSE"

BBFILE_COLLECTIONS += "owasys"
BBFILE_PATTERN_owasys := "^${LAYERDIR}/"
BBFILE_PRIORITY_owasys = "9"

LAYERSERIES_COMPAT_owasys = "zeus dunfell hardknott kirkstone"
```

## meta-ml-owasys/conf/layer.conf
```bitbake
# We have a conf and classes directory, add to BBPATH
BBPATH .= ":${LAYERDIR}"

# We have a packages directory, add to BBFILES
BBFILES += "${LAYERDIR}/recipes-*/*/*.bb \
            ${LAYERDIR}/recipes-*/*/*.bbappend"

BBFILE_COLLECTIONS += "meta-ml-owasys"
BBFILE_PATTERN_meta-ml-owasys := "^${LAYERDIR}/"
BBFILE_PRIORITY_meta-ml-owasys = "9"

LAYERDEPENDS_meta-ml-owasys = "core meta-ml owa5x"
LAYERSERIES_COMPAT_meta-ml-owasys = "zeus dunfell hardknott kirkstone"
```

## meta-owa5x/conf/layer.conf
```bitbake
# We have a conf and classes directory, add to BBPATH
BBPATH .= ":${LAYERDIR}"

# We have a packages directory, add to BBFILES
BBFILES += "${LAYERDIR}/recipes-*/*/*.bb \
            ${LAYERDIR}/recipes-*/*/*.bbappend"

# Add the Owasys licenses into the metadata
LICENSE_PATH += "${LAYERDIR}/custom-licenses"
COMPANY_CUSTOM_LICENSES := '${@os.path.normpath("${LAYERDIR}/custom-licenses")}'

FSL_EULA_FILE = "${LAYERDIR}/LICENSE"

BBFILE_COLLECTIONS += "owa5x"
BBFILE_PATTERN_owa5x := "^${LAYERDIR}/"
BBFILE_PRIORITY_owa5x = "9"

LAYERSERIES_COMPAT_owa5x = "zeus dunfell hardknott kirkstone"
```

## meta-owa5x/conf/machine/owa5x.conf
```bitbake
#@TYPE: Machine
#@NAME: Owasys Cetus - owa5x
#@SOC: i.MX8 MP
#@DESCRIPTION: Machine configuration for Owasys Cetus owa5x
#@MAINTAINER: Alvaro Guzman <alvaro.guzman@owasys.com>

 
require conf/machine/include/imx-base.inc
require conf/machine/include/arm/armv8a/tune-cortexa53.inc

# Kernel configuration
PREFERRED_PROVIDER_virtual/kernel ??= "linux-owasys-owa5x"
KERNEL_DEVICETREE += "freescale/imx8mp-owa5x.dtb "

KERNEL_IMAGETYPE = "Image"
RDEPENDS:${KERNEL_PACKAGE_NAME}-base = ""

# U-Boot configuration
PREFERRED_PROVIDER_u-boot ??= "u-boot-owasys"
PREFERRED_PROVIDER_virtual/bootloader ??= "u-boot-owasys"
PREFERRED_PROVIDER_imx-atf ??= "imx-atf-owasys"
SPL_BINARY = "spl/u-boot-spl.bin"
UBOOT_DTB_NAME ?= "imx8mp-owa5x.dtb"
UBOOT_MAKE_TARGET = ""
UBOOT_SUFFIX = "bin"

# Used to define the U-Boot defconfig for different board variants. The naming
# is here as a safeguard mechanism so that a user doesn't build and flash the
# wrong configuration.
#
# This method will be optimized in the future, but for now, use this variable to
# define the defconfig to be built.

UBOOT_CONFIG ??= "imx8mp_owa5x"
UBOOT_CONFIG[imx8mp_owa5x] = "imx8mp_owa5x_defconfig"

IMAGE_BOOTLOADER = "imx-boot-owasys"
ATF_PLATFORM = "imx8mp"
IMXBOOT_TARGETS = "flash_evk"
IMX_BOOT_SOC_TARGET = "iMX8MP"

DDR_FIRMWARE_NAME = "\
    lpddr4_pmu_train_1d_imem_202006.bin \
    lpddr4_pmu_train_1d_dmem_202006.bin \
    lpddr4_pmu_train_2d_imem_202006.bin \
    lpddr4_pmu_train_2d_dmem_202006.bin \
"
MACHINE_FEATURES += " wifi bluetooth"

MACHINEOVERRIDES_EXTENDER:owa5x = "imx-generic-bsp"
```

## meta-owasys-ml/conf/layer.conf
```bitbake
# We have a conf and classes directory, add to BBPATH
BBPATH .= ":${LAYERDIR}"

# We have a packages directory, add to BBFILES
BBFILES += "${LAYERDIR}/recipes-*/*/*.bb \
            ${LAYERDIR}/recipes-*/*/*.bbappend"

BBFILE_COLLECTIONS += "meta-owasys-ml"
BBFILE_PATTERN_meta-owasys-ml := "^${LAYERDIR}/"
BBFILE_PRIORITY_meta-owasys-ml = "9"

LAYERDEPENDS_meta-owasys-ml = "core meta-ml owasys-owa5x"
LAYERSERIES_COMPAT_meta-owasys-ml = "zeus dunfell hardknott kirkstone"
```

## meta-owasys-odm/conf/layer.conf
```bitbake
# We have a conf and classes directory, add to BBPATH
BBPATH .= ":${LAYERDIR}"

# We have a packages directory, add to BBFILES
BBFILES += "${LAYERDIR}/recipes-*/*/*.bb \
            ${LAYERDIR}/recipes-*/*/*.bbappend"

# Add the Owasys licenses into the metadata
LICENSE_PATH += "${LAYERDIR}/custom-licenses"
COMPANY_CUSTOM_LICENSES := '${@os.path.normpath("${LAYERDIR}/custom-licenses")}'

FSL_EULA_FILE = "${LAYERDIR}/LICENSE"

BBFILE_COLLECTIONS += "meta-owasys-odm"
BBFILE_PATTERN_meta-owasys-odm := "^${LAYERDIR}/"
BBFILE_PRIORITY_meta-owasys-odm = "9"

LAYERDEPENDS_meta-owasys-odm = "core rauc owasys-owa5x"
LAYERSERIES_COMPAT_meta-owasys-odm = "zeus dunfell hardknott kirkstone"
```

## meta-owasys-owa5x/conf/distro/cetus.conf
```bitbake
# Distro for owa5x ( Cetus ).

require conf/distro/include/fslc-base.inc

DISTRO = "cetus"
DISTRO_NAME = "owa5X"
DISTRO_CODENAME ="owa5X"
DISTRO_VERSION = "1.0.0"

# Remove conflicting backends
DISTRO_FEATURES:remove = " wayland directfb x11"
DISTRO_FEATURES:append = " pam systemd virtualization rauc"
VIRTUAL-RUNTIME_init_manager = "systemd"
MACHINEOVERRIDES =. "imx-generic-bsp"
```

## meta-owasys-owa5x/conf/layer.conf
```bitbake
# We have a conf and classes directory, add to BBPATH
BBPATH .= ":${LAYERDIR}"

# We have a packages directory, add to BBFILES
BBFILES += "${LAYERDIR}/recipes-*/*/*.bb \
            ${LAYERDIR}/recipes-*/*/*.bbappend"

# Add the Owasys licenses into the metadata
LICENSE_PATH += "${LAYERDIR}/custom-licenses"
COMPANY_CUSTOM_LICENSES := '${@os.path.normpath("${LAYERDIR}/custom-licenses")}'

FSL_EULA_FILE = "${LAYERDIR}/LICENSE"

BBFILE_COLLECTIONS += "owasys-owa5x"
BBFILE_PATTERN_owasys-owa5x := "^${LAYERDIR}/"
BBFILE_PRIORITY_owasys-owa5x = "9"

LAYERSERIES_COMPAT_owasys-owa5x = "zeus dunfell hardknott kirkstone"
```

## meta-owasys-security/conf/layer.conf
```bitbake
# This layer will hold all the countermeasures and security related recipes 
# of the owasys images.

# We have a conf and classes directory, add to BBPATH
BBPATH .= ":${LAYERDIR}"

# We have a packages directory, add to BBFILES
BBFILES += "${LAYERDIR}/recipes-*/*/*.bb \
            ${LAYERDIR}/recipes-*/*/*.bbappend"

BBFILE_COLLECTIONS += "meta-owasys-security"
BBFILE_PATTERN_meta-owasys-security := "^${LAYERDIR}/"
BBFILE_PRIORITY_meta-owasys-security = "9"

LAYERDEPENDS_meta-owasys-security = "core owasys-owa5x"
LAYERSERIES_COMPAT_meta-owasys-security = "zeus dunfell hardknott kirkstone"
```

## meta-rauc-owasys/conf/layer.conf
```bitbake
# We have a conf and classes directory, add to BBPATH
BBPATH .= ":${LAYERDIR}"

# We have a packages directory, add to BBFILES
BBFILES += "${LAYERDIR}/recipes-*/*/*.bb \
            ${LAYERDIR}/recipes-*/*/*.bbappend"

# Add the Owasys licenses into the metadata
LICENSE_PATH += "${LAYERDIR}/custom-licenses"
COMPANY_CUSTOM_LICENSES := '${@os.path.normpath("${LAYERDIR}/custom-licenses")}'

FSL_EULA_FILE = "${LAYERDIR}/LICENSE"

BBFILE_COLLECTIONS += "meta-rauc-owasys"
BBFILE_PATTERN_meta-rauc-owasys := "^${LAYERDIR}/"
BBFILE_PRIORITY_meta-rauc-owasys = "9"

LAYERDEPENDS_meta-rauc-owasys = "core rauc owa5x"
LAYERSERIES_COMPAT_meta-rauc-owasys = "zeus dunfell hardknott kirkstone"
```
